## Kconfig
```kconfig
# SPDX-License-Identifier: MIT

menu "ZMK Soft Off Plus"

config ZMK_SOFT_OFF_PLUS
	bool "ZMK soft-off-plus"
	depends on ZMK_PM_SOFT_OFF
	default y if DT_HAS_ZMK_BEHAVIOR_SOFT_OFF_PLUS_ENABLED || DT_HAS_ZMK_SOFT_OFF_PLUS_WAKE_ENABLED || DT_HAS_ZMK_BEHAVIOR_IF_USB_ENABLED
	help
	  Umbrella switch for the soft-off-plus module. Each feature below has its
	  own option and also auto-enables when its devicetree node is present, so
	  normally you only add the nodes you want. Requires ZMK soft off
	  (CONFIG_ZMK_PM_SOFT_OFF).

if ZMK_SOFT_OFF_PLUS

#
# Feature 1: enhanced soft-off behavior (+ optional split "both halves off")
#
config ZMK_SOFT_OFF_PLUS_BEHAVIOR
	bool "Enhanced soft-off behavior (zmk,behavior-soft-off-plus)"
	default y if DT_HAS_ZMK_BEHAVIOR_SOFT_OFF_PLUS_ENABLED
	help
	  Compile the &soft_off_plus behavior. It times its hold on whichever half
	  runs it; bind it from a keymap or a dedicated power/soft-off key.

config ZMK_SOFT_OFF_PLUS_SPLIT_SYNC
	bool "Power off both split halves together"
	depends on ZMK_SOFT_OFF_PLUS_BEHAVIOR && ZMK_SPLIT && BT
	default y if ZMK_SPLIT
	help
	  Triggering soft-off-plus on either half powers off both, via a dedicated
	  GATT characteristic (the central writes an off command to its
	  peripheral(s); a peripheral notifies the central).

config ZMK_SOFT_OFF_PLUS_SPLIT_SYNC_FLUSH_MS
	int "BLE off-signal flush delay (ms)"
	depends on ZMK_SOFT_OFF_PLUS_SPLIT_SYNC
	default 60
	help
	  Wait this long after sending the cross-half off signal before powering
	  off, so the BLE write/notification is transmitted first.

#
# Feature 2: boot-time "hold to wake" delay
#
config ZMK_SOFT_OFF_PLUS_WAKE_DELAY
	bool "Require a long press to wake from soft off"
	default y if DT_HAS_ZMK_SOFT_OFF_PLUS_WAKE_ENABLED
	select HWINFO
	select POWEROFF
	help
	  After waking from soft off (a System OFF reset on nRF), poll the wake
	  GPIO(s) and only continue booting if they stay active for wake-hold-ms;
	  otherwise re-arm the wake source and return to System OFF immediately.
	  Configure with a zmk,soft-off-plus-wake devicetree node.

config ZMK_SOFT_OFF_PLUS_WAKE_DELAY_INIT_PRIORITY
	int "Wake-delay boot check init priority (POST_KERNEL)"
	depends on ZMK_SOFT_OFF_PLUS_WAKE_DELAY
	default 50
	help
	  POST_KERNEL priority of the boot-time hold check. It must run before the
	  kscan that owns the wake pins; for a matrix wake key set this low (e.g. 1).

#
# Feature 3: USB-conditional wrapper (e.g. bootloader on the power key)
#
config ZMK_SOFT_OFF_PLUS_IF_USB
	bool "USB-conditional wrapper behavior (zmk,behavior-if-usb)"
	default y if DT_HAS_ZMK_BEHAVIOR_IF_USB_ENABLED
	help
	  Compile zmk,behavior-if-usb, which forwards to a child behavior only while
	  USB is powered on the half that runs it. Use it on a dedicated
	  power/soft-off key to gate &bootloader so DFU is only reachable on the
	  half that is plugged in.

module = ZMK_SOFT_OFF_PLUS
module-str = "ZMK Soft Off Plus"
source "subsys/logging/Kconfig.template.log_config"

endif # ZMK_SOFT_OFF_PLUS

endmenu
```

## dts/bindings/behaviors/zmk,behavior-if-usb.yaml
```yaml
# SPDX-License-Identifier: MIT
%YAML 1.2
---
description: |
  Forwards to a child behavior only while USB is connected/powered; otherwise
  does nothing. Each half evaluates its own USB state. Useful to gate a
  destructive action such as &bootloader so it only fires on the half that is
  plugged in.

compatible: "zmk,behavior-if-usb"

include: zero_param.yaml

properties:
  bindings:
    type: phandle-array
    required: true
    description: Behavior invoked (press and release forwarded) while USB is powered. The first entry is used.
...
```

## dts/bindings/behaviors/zmk,behavior-power-button.yaml
```yaml
# SPDX-License-Identifier: MIT
%YAML 1.2
---
description: |
  Split-safe gesture for a dedicated sideband power button. Holding the first
  press beyond tapping-term-ms presses the first child binding. A third quick
  press invokes the second child binding. Short single and double taps do
  nothing. Exactly two child bindings are required.

compatible: "zmk,behavior-power-button"

include: zero_param.yaml

properties:
  tapping-term-ms:
    type: int
    default: 300
    description: Time allowed between taps, and delay before committing a hold.

  bindings:
    type: phandle-array
    required: true
    description: First binding is hold; second binding is triple-tap.
...
```

## dts/bindings/behaviors/zmk,behavior-soft-off-plus.yaml
```yaml
# SPDX-License-Identifier: MIT
%YAML 1.2
---
description: |
  Enhanced soft-off behavior. Times the hold locally on whichever half runs it
  and, when CONFIG_ZMK_SOFT_OFF_PLUS_SPLIT_SYNC is enabled, powers off both
  halves of a split keyboard together over BLE.

compatible: "zmk,behavior-soft-off-plus"

include: zero_param.yaml

properties:
  hold-time-ms:
    type: int
    default: 0
    description: |
      How long the key must be held for soft-off to trigger. By default the
      trigger happens on release once this much time has elapsed (0 = trigger on
      release regardless of hold time). With trigger-on-hold, this is instead the
      delay after which soft-off fires while the key is still held.

  trigger-on-hold:
    type: boolean
    description: |
      Two-phase, phone-style power-off. When hold-time-ms elapses while the key
      is still held, the keyboard's components are dropped for visual
      confirmation -- every device's PM suspend runs (ext-power/display, radio,
      RGB, and anything added later) and the other split half is told to DROP
      too, so both halves blank while held on a matrix key or a sideband key.
      The half whose key is held defers its real System OFF until RELEASE, so the
      wake key's GPIO is inactive when it sleeps (this avoids the nRF trap where
      "setting the system to System OFF while DETECT is high causes a wakeup from
      System OFF reset," making it safe even when this key is also the wake
      source). A half with nothing held -- the non-wired half of a sideband
      press -- has no wake key down, so it powers off as soon as it receives the
      DROP, without waiting for a release to be relayed across the link.
      Releasing before hold-time-ms cancels with nothing dropped.
...
```

## dts/bindings/zmk/zmk,long-press-wake.yaml
```yaml
# SPDX-License-Identifier: MIT
%YAML 1.2
---
title: ZMK Long-Press Wake Controller

description: |
  This binding describes a controller that monitors one or more GPIO inputs for long-press events
  to wake the system from a soft-off state. It optionally controls external power rails and
  bypasses long-press enforcement when USB is present.

maintainers:
  - name: ZMK Contributors

compatible: "zmk,long-press-wake"

include: base.yaml

properties:
  wake-gpios:
    type: phandle-array
    required: true
    description: |
      GPIOs monitored as long-press wake inputs. These pins should also be
      configured as hardware wakeup sources in the SoC or board devicetree.

  required-hold-ms:
    type: int
    default: 3000
    description: Minimum duration in milliseconds that a wake input must remain active.

  bypass-on-usb:
    type: boolean
    description: Skip long-press enforcement when USB power is present.

  active-low:
    type: boolean
    description: Wake GPIOs are active when driven low. If absent, GPIOs are active high.

  ext-power-gpios:
    type: phandle-array
    description: Optional GPIOs controlling external power rails or peripherals.

  ext-power-on-delay-ms:
    type: int
    default: 0
    description: Delay in milliseconds before enabling external power after a valid wake.
...
```

## dts/bindings/zmk/zmk,soft-off-plus-wake.yaml
```yaml
# SPDX-License-Identifier: MIT
%YAML 1.2
---
description: |
  Boot-time "hold to wake" delay for ZMK soft off. When the device wakes from
  System OFF (a reset on nRF), the listed wake GPIO(s) must remain active for at
  least wake-hold-ms or the device immediately returns to System OFF.

compatible: "zmk,soft-off-plus-wake"

properties:
  wake-gpios:
    type: phandle-array
    required: true
    description: |
      GPIO input(s) polled at boot to detect the wake key being held. Use the
      same pin(s) and active-level flags as your soft-off wake key. For a matrix
      wake key this is the row (sense) line; also set strobe-gpios.

  strobe-gpios:
    type: phandle-array
    description: |
      Optional output(s) driven active while polling so a matrix wake key can be
      read (typically the column of the wake key). They are left driven when
      returning to System OFF so the key can wake the board again.

  wake-hold-ms:
    type: int
    default: 1000
    description: Milliseconds the wake input(s) must stay active to confirm a wake.

  bypass-on-usb:
    type: boolean
    description: |
      Skip the long hold requirement when USB power is present, after first
      confirming that a wake input is currently active. An inactive/spurious
      System OFF wake still returns immediately to System OFF.
...
```
